&qupv3_se7_i2c {
	status = "ok";
	goodix-gtx8@5d {
		compatible = "goodix,gt9886";
		reg = <0x5d>;
		goodix,avdd-name = "vtouch";
		vtouch-supply = <&pm8150_l13>;
		goodix,reset-gpio = <&tlmm 8 0x00>;
		goodix,irq-gpio = <&tlmm 9 0x2800>;
		goodix,irq-flags = <2>;
		goodix,panel-max-x = <1080>;
		goodix,panel-max-y = <2460>;
		goodix,panel-max-w = <255>;
		panel = <&dsi_visionox_rm692c9_amoled_fhd_10bit_dsc_cmd
			 &dsi_visionox_rm692c9_amoled_fhd_10bit_dsc_90hz_cmd>;
		goodix,edge-suppress-cmd = <0x50 0x0 0x0 0x0 0x50
			0x50 0x0 0x1 0x0 0x51
			0x50 0x0 0x2 0x0 0x52
			0x50 0x0 0x3 0x0 0x53
			0x41 0x0 0x0 0x0 0x41
			0x41 0x0 0x1 0x0 0x42
			0x41 0x0 0x2 0x0 0x43
			0x40 0x0 0x2 0x0 0x42
			0x40 0x0 0x1 0x0 0x41>;
	};
};
