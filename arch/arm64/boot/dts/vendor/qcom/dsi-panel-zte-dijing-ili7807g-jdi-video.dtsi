&mdss_mdp {
	dsi_dijing_ili7807g_jdi_video: qcom,dsi_dijing_ili7807g_jdi_video_display {
		qcom,mdss-dsi-panel-name = "Dijing-ILI7807G-JDI-1080-2340-6P53Inch";
		qcom,mdss-dsi-panel-type = "dsi_video_mode";
		qcom,dsi-ctrl-num = <0>;
		qcom,dsi-phy-num = <0>;
		qcom,mdss-dsi-virtual-channel-id = <0>;
		qcom,mdss-dsi-stream = <0>;
		qcom,mdss-dsi-bpp = <24>;
		qcom,mdss-dsi-color-order = "rgb_swap_rgb";
		qcom,mdss-dsi-underflow-color = <0xff>;
		qcom,mdss-dsi-border-color = <0>;
		qcom,mdss-dsi-h-sync-pulse = <0>;
		qcom,mdss-dsi-traffic-mode = "non_burst_sync_event";
		qcom,mdss-dsi-lane-map = "lane_map_0123";
		qcom,mdss-dsi-bllp-eof-power-mode;
		qcom,mdss-dsi-bllp-power-mode;
		qcom,mdss-dsi-lane-0-state;
		qcom,mdss-dsi-lane-1-state;
		qcom,mdss-dsi-lane-2-state;
		qcom,mdss-dsi-lane-3-state;
		qcom,mdss-dsi-lp11-init;
		qcom,mdss-dsi-reset-sequence = <1 10>, <0 20>, <1 20>;
		qcom,mdss-dsi-tx-eot-append;
		qcom,mdss-dsi-post-init-delay = <1>;
		qcom,mdss-dsi-dma-trigger = "trigger_sw";
		qcom,mdss-dsi-mdp-trigger = "none";
		qcom,mdss-dsi-bl-min-level = <16>;
		qcom,mdss-dsi-bl-max-level = <4095>;
		qcom,mdss-dsi-bl-pmic-control-type = "bl_ctrl_dcs";
		zte,lcd_vsp_vsn_voltage = <15>;
		zte,disp_vsp_en_gpio = <&tlmm 4 0>;
		zte,disp_vsn_en_gpio = <&tlmm 24 0>;
		zte,lcd_dimreg_value = <44>;
		qcom,mdss-dsi-panel-hdr-enabled;
		qcom,mdss-dsi-panel-hdr-color-primaries = <14500 15500 32000
			17000 15500 30000 8000 3000>;
		qcom,mdss-dsi-panel-peak-brightness = <4200000>;
		qcom,mdss-dsi-panel-blackness-level = <3230>;
		qcom,mdss-pan-physical-width-dimension = <69>;
		qcom,mdss-pan-physical-height-dimension = <151>;
		qcom,esd-check-enabled;
		qcom,mdss-dsi-panel-status-check-mode = "reg_read";
		qcom,mdss-dsi-panel-status-command = [06 01 00 01 00 00 01 0a];
		qcom,mdss-dsi-panel-status-command-state = "dsi_lp_mode";
		qcom,mdss-dsi-panel-status-value = <156>;
		qcom,mdss-dsi-panel-status-read-length = <1>;
		qcom,panel-supply-entries = <&dsi_panel_pwr_supply>;
		qcom,mdss-brightness-max-level = <255>;
		qcom,platform-te-gpio = <&tlmm 10 0>;
		qcom,platform-reset-gpio = <&pm8150l_gpios 3 0>;
		qcom,ulps-enabled;
		qcom,dsi-select-clocks = "mux_byte_clk0", "mux_pixel_clk0";
		qcom,mdss-dsi-display-timings {
			timing@0 {
				qcom,mdss-dsi-panel-width = <1080>;
				qcom,mdss-dsi-panel-height = <2340>;
				qcom,mdss-dsi-h-front-porch = <36>;
				qcom,mdss-dsi-h-back-porch = <36>;
				qcom,mdss-dsi-h-pulse-width = <4>;
				qcom,mdss-dsi-h-sync-skew = <0>;
				qcom,mdss-dsi-v-back-porch = <6>;
				qcom,mdss-dsi-v-front-porch = <38>;
				qcom,mdss-dsi-v-pulse-width = <2>;
				qcom,mdss-dsi-h-sync-pulse = <0>;
				qcom,mdss-dsi-h-left-border = <0>;
				qcom,mdss-dsi-h-right-border = <0>;
				qcom,mdss-dsi-v-top-border = <0>;
				qcom,mdss-dsi-v-bottom-border = <0>;
				qcom,mdss-dsi-panel-framerate = <60>;
				qcom,mdss-dsi-on-command = [
					39 01 00 00 00 00 04 ff 78 07 01
					39 01 00 00 00 00 02 00 41
					39 01 00 00 00 00 02 01 42
					39 01 00 00 00 00 02 02 2f
					39 01 00 00 00 00 02 03 2e
					39 01 00 00 00 00 02 9a 00
					39 01 00 00 00 00 02 9c 00
					39 01 00 00 00 00 02 04 c3
					39 01 00 00 00 00 02 05 03
					39 01 00 00 00 00 02 06 00
					39 01 00 00 00 00 02 07 0a
					39 01 00 00 00 00 02 08 01
					39 01 00 00 00 00 02 09 01
					39 01 00 00 00 00 02 0a 74
					39 01 00 00 00 00 02 0b 00
					39 01 00 00 00 00 02 0c 01
					39 01 00 00 00 00 02 0e 5e
					39 01 00 00 00 00 02 16 01
					39 01 00 00 00 00 02 17 00
					39 01 00 00 00 00 02 18 30
					39 01 00 00 00 00 02 19 00
					39 01 00 00 00 00 02 1a 20
					39 01 00 00 00 00 02 1c 12
					39 01 00 00 00 00 02 1e 00
					39 01 00 00 00 00 02 1f 00
					39 01 00 00 00 00 02 20 00
					39 01 00 00 00 00 02 21 00
					39 01 00 00 00 00 02 22 00
					39 01 00 00 00 00 02 31 07
					39 01 00 00 00 00 02 32 07
					39 01 00 00 00 00 02 33 07
					39 01 00 00 00 00 02 34 08
					39 01 00 00 00 00 02 35 07
					39 01 00 00 00 00 02 36 10
					39 01 00 00 00 00 02 37 07
					39 01 00 00 00 00 02 38 07
					39 01 00 00 00 00 02 39 1b
					39 01 00 00 00 00 02 3a 1a
					39 01 00 00 00 00 02 3b 19
					39 01 00 00 00 00 02 3c 18
					39 01 00 00 00 00 02 3d 07
					39 01 00 00 00 00 02 3e 07
					39 01 00 00 00 00 02 3f 07
					39 01 00 00 00 00 02 40 07
					39 01 00 00 00 00 02 41 07
					39 01 00 00 00 00 02 42 30
					39 01 00 00 00 00 02 43 2e
					39 01 00 00 00 00 02 44 2f
					39 01 00 00 00 00 02 45 07
					39 01 00 00 00 00 02 46 34
					39 01 00 00 00 00 02 47 35
					39 01 00 00 00 00 02 48 36
					39 01 00 00 00 00 02 49 07
					39 01 00 00 00 00 02 4a 29
					39 01 00 00 00 00 02 4b 07
					39 01 00 00 00 00 02 4c 00
					39 01 00 00 00 00 02 4d 07
					39 01 00 00 00 00 02 4e 10
					39 01 00 00 00 00 02 4f 07
					39 01 00 00 00 00 02 50 07
					39 01 00 00 00 00 02 51 1b
					39 01 00 00 00 00 02 52 1a
					39 01 00 00 00 00 02 53 19
					39 01 00 00 00 00 02 54 18
					39 01 00 00 00 00 02 55 07
					39 01 00 00 00 00 02 56 07
					39 01 00 00 00 00 02 57 07
					39 01 00 00 00 00 02 58 07
					39 01 00 00 00 00 02 59 07
					39 01 00 00 00 00 02 5a 30
					39 01 00 00 00 00 02 5b 2e
					39 01 00 00 00 00 02 5c 2f
					39 01 00 00 00 00 02 5d 07
					39 01 00 00 00 00 02 5e 34
					39 01 00 00 00 00 02 5f 35
					39 01 00 00 00 00 02 60 36
					39 01 00 00 00 00 02 61 07
					39 01 00 00 00 00 02 62 07
					39 01 00 00 00 00 02 63 07
					39 01 00 00 00 00 02 64 08
					39 01 00 00 00 00 02 65 07
					39 01 00 00 00 00 02 66 10
					39 01 00 00 00 00 02 67 07
					39 01 00 00 00 00 02 68 07
					39 01 00 00 00 00 02 69 18
					39 01 00 00 00 00 02 6a 19
					39 01 00 00 00 00 02 6b 1a
					39 01 00 00 00 00 02 6c 1b
					39 01 00 00 00 00 02 6d 07
					39 01 00 00 00 00 02 6e 07
					39 01 00 00 00 00 02 6f 07
					39 01 00 00 00 00 02 70 07
					39 01 00 00 00 00 02 71 07
					39 01 00 00 00 00 02 72 30
					39 01 00 00 00 00 02 73 2e
					39 01 00 00 00 00 02 74 2f
					39 01 00 00 00 00 02 75 07
					39 01 00 00 00 00 02 76 34
					39 01 00 00 00 00 02 77 35
					39 01 00 00 00 00 02 78 36
					39 01 00 00 00 00 02 79 07
					39 01 00 00 00 00 02 7a 29
					39 01 00 00 00 00 02 7b 07
					39 01 00 00 00 00 02 7c 00
					39 01 00 00 00 00 02 7d 07
					39 01 00 00 00 00 02 7e 10
					39 01 00 00 00 00 02 7f 07
					39 01 00 00 00 00 02 80 07
					39 01 00 00 00 00 02 81 18
					39 01 00 00 00 00 02 82 19
					39 01 00 00 00 00 02 83 1a
					39 01 00 00 00 00 02 84 1b
					39 01 00 00 00 00 02 85 07
					39 01 00 00 00 00 02 86 07
					39 01 00 00 00 00 02 87 07
					39 01 00 00 00 00 02 88 07
					39 01 00 00 00 00 02 89 07
					39 01 00 00 00 00 02 8a 30
					39 01 00 00 00 00 02 8b 2e
					39 01 00 00 00 00 02 8c 2f
					39 01 00 00 00 00 02 8d 07
					39 01 00 00 00 00 02 8e 34
					39 01 00 00 00 00 02 8f 35
					39 01 00 00 00 00 02 90 36
					39 01 00 00 00 00 02 a0 43
					39 01 00 00 00 00 02 a1 00
					39 01 00 00 00 00 02 a2 00
					39 01 00 00 00 00 02 a3 00
					39 01 00 00 00 00 02 a4 00
					39 01 00 00 00 00 02 a5 00
					39 01 00 00 00 00 02 a6 0a
					39 01 00 00 00 00 02 a7 40
					39 01 00 00 00 00 02 a8 10
					39 01 00 00 00 00 02 b0 00
					39 01 00 00 00 00 02 b1 00
					39 01 00 00 00 00 02 b2 00
					39 01 00 00 00 00 02 b3 00
					39 01 00 00 00 00 02 c5 0a
					39 01 00 00 00 00 02 c6 00
					39 01 00 00 00 00 02 c7 00
					39 01 00 00 00 00 02 c8 00
					39 01 00 00 00 00 02 c9 00
					39 01 00 00 00 00 02 ca 71
					39 01 00 00 00 00 02 d1 10
					39 01 00 00 00 00 02 d2 40
					39 01 00 00 00 00 02 d3 00
					39 01 00 00 00 00 02 d4 22
					39 01 00 00 00 00 02 d5 00
					39 01 00 00 00 00 02 d6 21
					39 01 00 00 00 00 02 d7 03
					39 01 00 00 00 00 02 d8 c0
					39 01 00 00 00 00 02 d9 24
					39 01 00 00 00 00 02 da 01
					39 01 00 00 00 00 02 db 09
					39 01 00 00 00 00 02 dc 08
					39 01 00 00 00 00 02 dd c4
					39 01 00 00 00 00 02 de 00
					39 01 00 00 00 00 02 df 80
					39 01 00 00 00 00 02 e0 40
					39 01 00 00 00 00 02 e1 08
					39 01 00 00 00 00 02 e2 00
					39 01 00 00 00 00 02 e3 20
					39 01 00 00 00 00 02 e4 00
					39 01 00 00 00 00 02 e5 09
					39 01 00 00 00 00 02 e6 21
					39 01 00 00 00 00 02 ed 55
					39 01 00 00 00 00 02 ef 30
					39 01 00 00 00 00 02 f0 64
					39 01 00 00 00 00 04 ff 78 07 02
					39 01 00 00 00 00 02 01 35
					39 01 00 00 00 00 02 06 73
					39 01 00 00 00 00 02 07 73
					39 01 00 00 00 00 02 72 02
					39 01 00 00 00 00 02 73 00
					39 01 00 00 00 00 02 78 26
					39 01 00 00 00 00 02 79 26
					39 01 00 00 00 00 02 40 07
					39 01 00 00 00 00 02 41 00
					39 01 00 00 00 00 02 42 04
					39 01 00 00 00 00 02 43 15
					39 01 00 00 00 00 02 4e c4
					39 01 00 00 00 00 02 4f 01
					39 01 00 00 00 00 02 53 04
					39 01 00 00 00 00 02 54 05
					39 01 00 00 00 00 02 56 02
					39 01 00 00 00 00 02 5d 07
					39 01 00 00 00 00 02 47 02
					39 01 00 00 00 00 02 f4 41
					39 01 00 00 00 00 02 f5 00
					39 01 00 00 00 00 02 f6 00
					39 01 00 00 00 00 02 f7 00
					39 01 00 00 00 00 02 f9 34
					39 01 00 00 00 00 04 ff 78 07 04
					39 01 00 00 00 00 02 b7 f0
					39 01 00 00 00 00 04 ff 78 07 05
					39 01 00 00 00 00 02 27 44
					39 01 00 00 00 00 02 28 54
					39 01 00 00 00 00 02 a0 44
					39 01 00 00 00 00 02 a2 54
					39 01 00 00 00 00 02 bc 54
					39 01 00 00 00 00 02 2b 08
					39 01 00 00 00 00 02 03 00
					39 01 00 00 00 00 02 04 85
					39 01 00 00 00 00 02 63 7e
					39 01 00 00 00 00 02 64 7e
					39 01 00 00 00 00 02 69 5a
					39 01 00 00 00 00 02 6b 52
					39 01 00 00 00 00 02 68 55
					39 01 00 00 00 00 02 6a 4d
					39 01 00 00 00 00 04 ff 78 07 06
					39 01 00 00 00 00 02 07 f5
					39 01 00 00 00 00 02 d6 67
					39 01 00 00 00 00 02 c3 06
					39 01 00 00 00 00 02 2e 01
					39 01 00 00 00 00 02 c0 91
					39 01 00 00 00 00 02 c1 04
					39 01 00 00 00 00 02 11 03
					39 01 00 00 00 00 02 12 10
					39 01 00 00 00 00 02 13 5c
					39 01 00 00 00 00 02 14 41
					39 01 00 00 00 00 02 15 19
					39 01 00 00 00 00 02 16 41
					39 01 00 00 00 00 02 17 47
					39 01 00 00 00 00 02 18 3a
					39 01 00 00 00 00 02 1d df
					39 01 00 00 00 00 02 1e 02
					39 01 00 00 00 00 02 b4 ca
					39 01 00 00 00 00 02 b5 17
					39 01 00 00 00 00 04 ff 78 07 07
					39 01 00 00 00 00 02 06 90
					39 01 00 00 00 00 04 ff 78 07 08
					39 01 00 00 00 00 29 e0 00 00 16 3e 00 60 7b 92 00 a7 b9 ca 15 00 2a 6a 25 99 e1 1b 2a 1d 54 94 3a bd f1 14 3f 40 4e 5c 3f 6c 7f 95 3f b0 cc e6
					39 01 00 00 00 00 29 e1 00 00 16 3e 00 60 7b 92 00 a7 b9 ca 15 00 2a 6a 25 99 e1 1b 2a 1d 54 94 3a bd f1 14 3f 40 4e 5c 3f 6c 7f 95 3f b0 cc e6
					39 01 00 00 00 00 04 ff 78 07 09
					39 01 00 00 00 00 29 e0 00 00 17 41 00 64 80 98 00 ad bf d0 15 08 31 70 25 9f e6 20 2a 21 59 97 3a c0 f4 17 3f 42 50 5e 3f 6e 80 95 3f af d6 e6
					39 01 00 00 00 00 29 e1 00 00 17 41 00 64 80 98 00 ad bf d0 15 08 31 70 25 9f e6 20 2a 21 59 97 3a c0 f4 17 3f 42 50 5e 3f 6e 80 95 3f af d6 e6
					39 01 00 00 00 00 04 ff 78 07 0a
					39 01 00 00 00 00 29 e0 00 00 17 44 00 66 81 98 00 ad bf cf 15 04 2d 6b 25 99 e0 1a 2a 1c 53 93 3a bc f1 13 3f 3f 4d 5b 3f 6b 7e 92 3f ad d6 e6
					39 01 00 00 00 00 29 e1 00 00 17 44 00 66 81 98 00 ad bf cf 15 04 2d 6b 25 99 e0 1a 2a 1c 53 93 3a bc f1 13 3f 3f 4d 5b 3f 6b 7e 92 3f ad d6 e6
					39 01 00 00 00 00 04 ff 78 07 0e
					39 01 00 00 00 00 02 00 a3
					39 01 00 00 00 00 02 4d 5f
					39 01 00 00 00 00 02 41 08
					39 01 00 00 00 00 02 43 b3
					39 01 00 00 00 00 02 47 80
					39 01 00 00 00 00 02 49 c3
					39 01 00 00 00 00 02 b0 01
					39 01 00 00 00 00 02 b1 60
					39 01 00 00 00 00 02 b2 60
					39 01 00 00 00 00 02 b3 00
					39 01 00 00 00 00 02 b4 33
					39 01 00 00 00 00 02 45 0a
					39 01 00 00 00 00 02 46 61
					39 01 00 00 00 00 02 bc 04
					39 01 00 00 00 00 02 bd fc
					39 01 00 00 00 00 02 c0 34
					39 01 00 00 00 00 02 c6 60
					39 01 00 00 00 00 02 c7 60
					39 01 00 00 00 00 02 c8 60
					39 01 00 00 00 00 02 c9 60
					39 01 00 00 00 00 02 d2 00
					39 01 00 00 00 00 02 d3 a8
					39 01 00 00 00 00 02 d4 00
					39 01 00 00 00 00 02 d5 a8
					39 01 00 00 00 00 02 d6 00
					39 01 00 00 00 00 02 d7 a8
					39 01 00 00 00 00 02 d8 00
					39 01 00 00 00 00 02 d9 a8
					39 01 00 00 00 00 02 e0 07
					39 01 00 00 00 00 02 e1 00
					39 01 00 00 00 00 02 e2 04
					39 01 00 00 00 00 02 e3 15
					39 01 00 00 00 00 02 e4 04
					39 01 00 00 00 00 02 e5 04
					39 01 00 00 00 00 02 e6 00
					39 01 00 00 00 00 02 e7 05
					39 01 00 00 00 00 02 e8 00
					39 01 00 00 00 00 02 e9 02
					39 01 00 00 00 00 02 ea 07
					39 01 00 00 00 00 04 ff 78 07 0e
					39 01 00 00 00 00 02 07 21
					39 01 00 00 00 00 02 4b 14
					39 01 00 00 00 00 04 ff 78 07 0c
					39 01 00 00 00 00 02 00 19
					39 01 00 00 00 00 02 01 2a
					39 01 00 00 00 00 02 02 17
					39 01 00 00 00 00 02 03 1c
					39 01 00 00 00 00 02 04 17
					39 01 00 00 00 00 02 05 19
					39 01 00 00 00 00 02 06 17
					39 01 00 00 00 00 02 07 16
					39 01 00 00 00 00 02 08 18
					39 01 00 00 00 00 02 09 1e
					39 01 00 00 00 00 02 0a 19
					39 01 00 00 00 00 02 0b 29
					39 01 00 00 00 00 02 0c 17
					39 01 00 00 00 00 02 0d 18
					39 01 00 00 00 00 02 0e 19
					39 01 00 00 00 00 02 0f 27
					39 01 00 00 00 00 02 10 18
					39 01 00 00 00 00 02 11 1d
					39 01 00 00 00 00 02 12 18
					39 01 00 00 00 00 02 13 20
					39 01 00 00 00 00 02 14 19
					39 01 00 00 00 00 02 15 25
					39 01 00 00 00 00 02 16 17
					39 01 00 00 00 00 02 17 1a
					39 01 00 00 00 00 02 18 19
					39 01 00 00 00 00 02 19 28
					39 01 00 00 00 00 02 1a 17
					39 01 00 00 00 00 02 1b 1b
					39 01 00 00 00 00 02 1c 18
					39 01 00 00 00 00 02 1d 21
					39 01 00 00 00 00 02 1e 19
					39 01 00 00 00 00 02 1f 26
					39 01 00 00 00 00 02 20 18
					39 01 00 00 00 00 02 21 24
					39 01 00 00 00 00 02 22 18
					39 01 00 00 00 00 02 23 1f
					39 01 00 00 00 00 02 24 17
					39 01 00 00 00 00 02 25 17
					39 01 00 00 00 00 02 26 18
					39 01 00 00 00 00 02 27 23
					39 01 00 00 00 00 02 28 18
					39 01 00 00 00 00 02 29 22
					39 01 00 00 00 00 04 ff 78 07 03
					39 01 00 00 00 00 02 83 40
					39 01 00 00 00 00 02 84 00
					39 01 00 00 00 00 04 ff 78 07 00
					39 01 00 00 00 00 03 51 00 00
					39 01 00 00 00 00 03 68 04 01
					39 01 00 00 00 00 02 53 24
					39 01 00 00 0a 00 02 55 01
					05 01 00 00 78 00 02 11 00
					05 01 00 00 0a 00 02 29 00
				];
				qcom,mdss-dsi-off-command = [
					05 01 00 00 32 00 02 28 00
					05 01 00 00 78 00 02 10 00
				];
				qcom,mdss-dsi-on-command-state = "dsi_lp_mode";
				qcom,mdss-dsi-off-command-state = "dsi_lp_mode";
				qcom,mdss-dsi-panel-phy-timings = [00 22 08 09 25 23 09 09 06 02 04 00 1c 18];
				qcom,display-topology = <1 0 1>;
				qcom,default-topology-index = <0>;
			};
		};
	};
};
