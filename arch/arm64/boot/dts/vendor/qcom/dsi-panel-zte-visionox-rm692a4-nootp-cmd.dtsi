&mdss_mdp {
	dsi_visionox_rm692a4_nootp_cmd: qcom,dsi_visionox_rm692a4_nootp_cmd_display {
		qcom,mdss-dsi-panel-name = "Visionox-RM692A4-nootp240nit-1080-2340-6P5Inch";
		qcom,mdss-dsi-panel-type = "dsi_cmd_mode";
		qcom,mdss-dsi-panel-physical-type = "oled";
		qcom,dsi-ctrl-num = <0>;
		qcom,dsi-phy-num = <0>;
		qcom,mdss-dsi-virtual-channel-id = <0>;
		qcom,mdss-dsi-stream = <0>;
		qcom,mdss-dsi-bpp = <24>;
		qcom,mdss-dsi-underflow-color = <0xff>;
		qcom,mdss-dsi-border-color = <0>;
		qcom,mdss-dsi-traffic-mode = "burst_mode";
		qcom,mdss-dsi-te-pin-select = <1>;
		qcom,mdss-dsi-te-dcs-command = <1>;
		qcom,mdss-dsi-te-check-enable;
		qcom,mdss-dsi-te-using-te-pin;
		qcom,mdss-dsi-bllp-eof-power-mode;
		qcom,mdss-dsi-bllp-power-mode;
		qcom,mdss-dsi-lane-0-state;
		qcom,mdss-dsi-lane-1-state;
		qcom,mdss-dsi-lane-2-state;
		qcom,mdss-dsi-lane-3-state;
		qcom,mdss-dsi-lp11-init;
		qcom,mdss-dsi-reset-sequence = <1 5>, <0 10>, <1 10>;
		qcom,mdss-dsi-tx-eot-append;
		qcom,mdss-dsi-post-init-delay = <1>;
		qcom,mdss-dsi-dma-trigger = "trigger_sw";
		qcom,mdss-dsi-mdp-trigger = "none";
		qcom,mdss-dsi-bl-min-level = <6>;
		qcom,mdss-dsi-bl-max-level = <2047>;
		qcom,mdss-dsi-bl-pmic-control-type = "bl_ctrl_dcs";
		qcom,mdss-dsi-panel-hdr-enabled;
		qcom,mdss-dsi-panel-hdr-color-primaries = <14880 15935 32435
			16555 14945 30910 7790 3415>;
		qcom,mdss-dsi-panel-peak-brightness = <5643000>;
		qcom,mdss-dsi-panel-blackness-level = <6134>;
		qcom,mdss-pan-physical-width-dimension = <69>;
		qcom,mdss-pan-physical-height-dimension = <149>;
		qcom,panel-supply-entries = <&dsi_panel_pwr_supply>;
		qcom,mdss-brightness-max-level = <255>;
		qcom,platform-te-gpio = <&tlmm 10 0>;
		qcom,platform-reset-gpio = <&pm8150l_gpios 3 0>;
		zte,lcd_dimreg_value = <0x28>;
		qcom,ulps-enabled;
		qcom,dsi-select-clocks = "mux_byte_clk0", "mux_pixel_clk0";
		qcom,mdss-dsi-display-timings {
			timing@0 {
				qcom,mdss-dsi-panel-width = <1080>;
				qcom,mdss-dsi-panel-height = <2340>;
				qcom,mdss-dsi-h-front-porch = <60>;
				qcom,mdss-dsi-h-back-porch = <60>;
				qcom,mdss-dsi-h-pulse-width = <8>;
				qcom,mdss-dsi-h-sync-skew = <0>;
				qcom,mdss-dsi-v-back-porch = <24>;
				qcom,mdss-dsi-v-front-porch = <24>;
				qcom,mdss-dsi-v-pulse-width = <8>;
				qcom,mdss-dsi-h-sync-pulse = <0>;
				qcom,mdss-dsi-h-left-border = <0>;
				qcom,mdss-dsi-h-right-border = <0>;
				qcom,mdss-dsi-v-top-border = <0>;
				qcom,mdss-dsi-v-bottom-border = <0>;
				qcom,mdss-dsi-panel-framerate = <60>;
				qcom,mdss-dsi-on-command = [
					39 01 00 00 00 00 02 fe d0
					39 01 00 00 00 00 02 45 41
					39 01 00 00 00 00 02 fe 72
					39 01 00 00 00 00 02 69 30
					39 01 00 00 00 00 02 fe 40
					39 01 00 00 00 00 02 9a 01
					39 01 00 00 00 00 02 82 40
					39 01 00 00 00 00 02 fe 12
					39 01 00 00 00 00 02 83 30
					39 01 00 00 00 00 02 fe 00
					39 01 00 00 00 00 02 5c 0f
					39 01 00 00 00 00 02 fe 80
					39 01 00 00 00 00 02 00 47
					39 01 00 00 00 00 02 05 10
					39 01 00 00 00 00 02 fe 00
					39 01 00 00 00 00 02 5a 0b
					39 01 00 00 00 00 02 fe 80
					39 01 00 00 00 00 02 00 0b
					39 01 00 00 00 00 02 08 00
					39 01 00 00 00 00 02 09 00
					39 01 00 00 00 00 02 0a 0d
					39 01 00 00 00 00 02 0b 00
					39 01 00 00 00 00 02 0c 00
					39 01 00 00 00 00 02 0d 00
					39 01 00 00 00 00 02 0e ef
					39 01 00 00 00 00 02 0f 0f
					39 01 00 00 00 00 02 14 00
					39 01 00 00 00 00 02 15 00
					39 01 00 00 00 00 02 16 00
					39 01 00 00 00 00 02 17 00
					39 01 00 00 00 00 02 18 00
					39 01 00 00 00 00 02 19 00
					39 01 00 00 00 00 02 1a 00
					39 01 00 00 00 00 02 1b 00
					39 01 00 00 00 00 02 fe 00
					39 01 00 00 00 00 02 c2 08
					39 01 00 00 00 00 02 35 00
					39 01 00 00 00 00 03 51 00 00
					39 01 00 00 00 00 02 53 20
					05 01 00 00 5a 00 02 11 00
					05 01 00 00 0a 00 02 29 00
					39 01 00 00 14 00 0c 83 00 00 00 43 04 7e 01 17 02 0b 06
					39 01 00 00 00 00 02 fe 00
				];
				qcom,mdss-dsi-off-command = [
					39 01 00 00 00 00 02 fe 00
					39 01 00 00 8c 00 03 51 00 00
					05 01 00 00 14 00 02 28 00
					05 01 00 00 14 00 02 10 00
				];
				qcom,mdss-dsi-on-command-state = "dsi_lp_mode";
				qcom,mdss-dsi-off-command-state = "dsi_lp_mode";
				qcom,mdss-dsi-lp1-command = [
					39 01 00 00 28 00 02 fe 00
					05 01 00 00 00 00 02 39 00
					39 01 00 00 00 00 02 fe d0
					39 01 00 00 14 00 02 30 03
					39 01 00 00 00 00 02 fe 20
					39 01 00 00 00 00 02 5f 07
					39 01 00 00 00 00 02 fe 00
				];
				qcom,mdss-dsi-lp1-command-state = "dsi_lp_mode";
				qcom,mdss-dsi-nolp-command = [
					39 01 00 00 00 00 02 fe d0
					39 01 00 00 14 00 02 30 00
					39 01 00 00 00 00 02 fe 20
					39 01 00 00 00 00 02 5f 01
					39 01 00 00 28 00 02 fe 00
					05 01 00 00 14 00 02 38 00
				];
				qcom,mdss-dsi-nolp-command-state = "dsi_lp_mode";
				zte,mdss-dsi-hbm-on-commands = [
					39 01 00 00 00 00 02 fe 40
					39 01 00 00 00 00 02 1d b8
					39 01 00 00 00 00 02 fe d0
					39 01 00 00 00 00 02 71 01
					39 01 00 00 01 00 02 fb aa
					39 01 00 00 00 00 02 fe 74
					39 01 00 00 00 00 02 0e 60
					39 01 00 00 00 00 02 10 05
					39 01 00 00 00 00 02 19 20
					39 01 00 00 00 00 02 38 00
					39 01 00 00 00 00 02 3a ff
					39 01 00 00 00 00 02 3d ff
					39 01 00 00 00 00 02 41 ff
					39 01 00 00 00 00 02 45 ff
					39 01 00 00 00 00 02 46 ff
					39 01 00 00 00 00 02 58 60
					39 01 00 00 00 00 02 fe 00
					39 01 00 00 46 00 02 83 01
					39 01 00 00 00 00 02 fe 40
					39 01 00 00 00 00 02 1d f8
					39 01 00 00 00 00 02 fe d0
					39 01 00 00 00 00 02 71 02
					39 01 00 00 14 00 02 fb aa
					39 01 00 00 00 00 02 fe 00
				];
				zte,mdss-dsi-hbm-off-commands = [
					39 01 00 00 00 00 02 fe 40
					39 01 00 00 00 00 02 1d b8
					39 01 00 00 00 00 02 fe d0
					39 01 00 00 00 00 02 71 01
					39 01 00 00 01 00 02 fb aa
					39 01 00 00 00 00 02 fe 74
					39 01 00 00 00 00 02 0e 78
					39 01 00 00 00 00 02 10 04
					39 01 00 00 00 00 02 19 08
					39 01 00 00 00 00 02 38 38
					39 01 00 00 00 00 02 3a f2
					39 01 00 00 00 00 02 3d 62
					39 01 00 00 00 00 02 41 00
					39 01 00 00 00 00 02 45 00
					39 01 00 00 00 00 02 46 00
					39 01 00 00 00 00 02 58 78
					39 01 00 00 00 00 02 fe 00
					39 01 00 00 46 00 02 83 00
					39 01 00 00 00 00 02 fe 40
					39 01 00 00 00 00 02 1d f8
					39 01 00 00 00 00 02 fe d0
					39 01 00 00 00 00 02 71 02
					39 01 00 00 14 00 02 fb aa
					39 01 00 00 00 00 02 fe 00
				];
				zte,mdss-dsi-aod-low-commands = [
					39 01 00 00 00 00 02 fe 72
					39 01 00 00 00 00 02 69 04
					39 01 00 00 00 00 02 fe 00
				];
				zte,mdss-dsi-aod-mid-commands = [
					39 01 00 00 00 00 02 fe 72
					39 01 00 00 00 00 02 69 30
					39 01 00 00 00 00 02 fe 00
				];
				zte,mdss-dsi-aod-high-commands = [
					39 01 00 00 00 00 02 fe 72
					39 01 00 00 00 00 02 69 ff
					39 01 00 00 00 00 02 fe 00
				];
				zte,mdss-dsi-hbm-on-commands-state = "dsi_hs_mode";
				zte,mdss-dsi-hbm-off-commands-state = "dsi_hs_mode";
				zte,mdss-dsi-aod-low-commands-state = "dsi_hs_mode";
				zte,mdss-dsi-aod-mid-commands-state = "dsi_hs_mode";
				zte,mdss-dsi-aod-high-commands-state = "dsi_hs_mode";
				qcom,mdss-dsi-panel-phy-timings = [00 23 09 09 26 24 09 09 06 02 04 00 1d 19];
				qcom,display-topology = <1 0 1>;
				qcom,default-topology-index = <0>;
				qcom,mdss-dsi-panel-clockrate = <1050000000>;
			};
		};
	};
};
