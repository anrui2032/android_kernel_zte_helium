/dts-v1/;

#include "lito-v2.dtsi"
#include "lito-mtp.dtsi"
#include "lito-v2-audio.dtsi"
#include "zte-helium-overlay.dtsi"

/ {
	model = "Qualcomm Technologies, Inc. Lito v2 MTP";
	compatible = "qcom,lito-mtp", "qcom,lito", "qcom,mtp";
	qcom,board-id = <5 0>;
};

&ufsphy_mem {
	/delete-property/ vdda-phy-always-on;
};
